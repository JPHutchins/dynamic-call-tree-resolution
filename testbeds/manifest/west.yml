## testbeds/manifest/west.yml
```yaml
manifest:
  projects:
    - name: zephyr
      url: https://github.com/zephyrproject-rtos/zephyr
      revision: e560c91b1f74146baa3177b07b92a8733c60b7c7
      import:
        name-allowlist:
          - cmsis_6
  self:
    path: manifest
```
